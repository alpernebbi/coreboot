## src/drivers/emulation/qemu/Kconfig
```kconfig
## SPDX-License-Identifier: GPL-2.0-only

config DRIVERS_EMULATION_QEMU_BOCHS
	bool "bochs dispi interface vga driver"
	default y
	depends on PCI
	depends on VENDOR_EMULATION
	depends on MAINBOARD_DO_NATIVE_VGA_INIT
	select HAVE_VGA_TEXT_FRAMEBUFFER if CPU_QEMU_X86
	select HAVE_LINEAR_FRAMEBUFFER
	select VGA
	help
	   VGA driver for qemu emulated vga cards supporting
	   the bochs dispi interface.  This includes
	   standard vga, vmware svga, and qxl.

config DRIVERS_EMULATION_QEMU_CIRRUS
	bool "cirrus svga driver"
	default y
	depends on PCI
	depends on VENDOR_EMULATION
	depends on MAINBOARD_DO_NATIVE_VGA_INIT
	select HAVE_VGA_TEXT_FRAMEBUFFER if CPU_QEMU_X86
	select HAVE_LINEAR_FRAMEBUFFER
	select VGA
	help
	   VGA driver for qemu emulated cirrus svga card.

config DRIVERS_EMULATION_QEMU_RAMFB
	bool "ramfb driver"
	default y
	depends on VENDOR_EMULATION
	depends on MAINBOARD_DO_NATIVE_VGA_INIT
	select HAVE_LINEAR_FRAMEBUFFER
	help
	   Graphics driver for qemu emulated ramfb device.

config DRIVERS_EMULATION_QEMU_XRES
	int "qemu vga xres"
	default 800
	depends on LINEAR_FRAMEBUFFER
	depends on DRIVERS_EMULATION_QEMU_BOCHS || DRIVERS_EMULATION_QEMU_CIRRUS

config DRIVERS_EMULATION_QEMU_YRES
	int "qemu vga yres"
	default 600
	depends on LINEAR_FRAMEBUFFER
	depends on DRIVERS_EMULATION_QEMU_BOCHS || DRIVERS_EMULATION_QEMU_CIRRUS

config DRIVERS_EMULATION_QEMU_FW_CFG
	bool
	depends on VENDOR_EMULATION
	help
	   Driver for QEMU-specific device that passes various config
	   information to the firmware including e.g. ACPI and SMBIOS
	   tables.

config QEMU_FW_CFG_BASE_ADDRESS
	hex
	depends on DRIVERS_EMULATION_QEMU_FW_CFG && !CPU_QEMU_X86
	help
	    Platform dependent base address of the MMIO (and DMA)
	    registers for the QEMU firmware configuration device.
```

## src/mainboard/emulation/qemu-armv7-virt/Kconfig
```kconfig
# SPDX-License-Identifier: GPL-2.0-or-later

# Emulation for QEMU 2.8 ARM Virtual Machine (alias of virt-2.8)
# https://wiki.qemu.org/Documentation/Platforms/ARM

if BOARD_EMULATION_QEMU_ARMV7_VIRT

config BOARD_SPECIFIC_OPTIONS
	def_bool y
	select ARCH_BOOTBLOCK_ARMV7
	select ARCH_VERSTAGE_ARMV7
	select ARCH_ROMSTAGE_ARMV7
	select ARCH_RAMSTAGE_ARMV7
	select NO_MONOTONIC_TIMER
	select BOARD_ROMSIZE_KB_4096
	select BOOT_DEVICE_NOT_SPI_FLASH
	select DRIVERS_UART_PL011
	select HAVE_LINEAR_FRAMEBUFFER
	select MAINBOARD_FORCE_NATIVE_VGA_INIT
	select MAINBOARD_HAS_NATIVE_VGA_INIT
	select MISSING_BOARD_RESET
	select FLATTENED_DEVICE_TREE
	select PCI

config ECAM_MMCONF_BASE_ADDRESS
	default 0x3f000000

config ECAM_MMCONF_LENGTH
	default 0x01000000

config ECAM_MMCONF_BUS_NUMBER
	default 16

config MEMLAYOUT_LD_FILE
	string
	default "src/mainboard/emulation/qemu-armv7-virt/memlayout.ld"

config MAINBOARD_DIR
	default "emulation/qemu-armv7-virt"

config MAINBOARD_PART_NUMBER
	default "QEMU ARMv7 Generic Virtual Platform"

config MAX_CPUS
	int
	default 2

config MAINBOARD_VENDOR
	string
	default "QEMU"

config DRAM_SIZE_MB
	int
	default 3072 # DRAM starts at 1GiB, max 3GiB due to 32-bit

endif #  BOARD_EMULATION_QEMU_ARMV7_VIRT
```
